// Copyright 2023 QMK
// SPDX-License-Identifier: GPL-2.0-or-later

#include QMK_KEYBOARD_H
#include <stdio.h>

#define ANIM_FRAME_DURATION 150 // how long each frame lasts in ms
#define ANIM_SIZE 636 // number of bytes in array, minimize for adequate firmware size, max is 1024
#define IDLE_FRAMES 5
#define IDLE_TIMEOUT 750 // the amount of time it takes to return to idle
#define TAP_FRAMES 2
#define KEYS_SIZE 20 // the number of keys stored in the array that tracks keypresses; how many keys are on the board?

enum anim_states {
    Idle,
    Prep,
    Tap
};

uint8_t anim_state = Idle;
uint32_t idle_timeout_timer = 0;
uint32_t anim_timer = 0;
uint8_t current_idle_frame = 0;
uint8_t current_tap_frame = 0;

struct pair_int_int {
    uint8_t first;
    uint8_t second;
};

struct pair_int_int pressed_keys[KEYS_SIZE];
struct pair_int_int pressed_keys_prev[KEYS_SIZE];
uint8_t pressed_keys_index = 0;

bool key_down = 0;
char wpm_str[42];

// Layer names for each layer
enum layer_names {
    _MAC_NUMPAD,
    _MAC_NUM_LOCK,
    _MAC_SYMBOLS
};

// Variable names for unicode symbols
enum unicode_names {
    BANG,
    IRONY,
    SNEK,
    MU,
    SIGMA,
    DEGREE,
    PLSMNS
};

// Assign unicode symbols
const uint32_t PROGMEM unicode_map[] = {
    [BANG]  = 0x203D,  // ‽
    [IRONY] = 0x2E2E,  // ⸮
    [SNEK]  = 0x1F40D, // 🐍
    [MU]    = 0x03BC, // μ
    [SIGMA] = 0x03C3, // σ
    [DEGREE]= 0x00B0, // °
    [PLSMNS]= 0x00B1, // ±
};

// Keymaps
const uint16_t PROGMEM keymaps[][MATRIX_ROWS][MATRIX_COLS] = {
     /*
     * ┌───┬───┬───┬───┐
     * │TG1│CAP│ / │ M │
     * ├───┼───┼───┼───┤
     * │ 7 │ 8 │ 9 │ * │
     * ├───┼───┼───┼───┤
     * │ 4 │ 5 │ 6 │ - │
     * ├───┼───┼───┼───┤
     * │ 1 │ 2 │ 3 │ + │
     * ├───┼───┼───┼───┤
     * │ 0 │ . │ = │ENT│
     * └───┴───┴───┴───┘
     */
    [0] = LAYOUT_numpad_5x4(
        TO(1),    KC_CAPS,  KC_PSLS,  KC_MUTE,
        KC_A,    KC_B,    KC_C,    KC_PAST,
        KC_D,    KC_E,    KC_F,    KC_PMNS,
        KC_G,    KC_H,    KC_I,    KC_PPLS,
        KC_SPC,    KC_PDOT,  KC_PEQL,  KC_PENT
    ),

     /*
     * ┌───┬───┬───┬───┐
     * │TG1│CAP│ / │ M │
     * ┌───┬───┬───┬───┤
     * │Hom│ ↑ │PgU│ * │
     * ├───┼───┼───┼───┤
     * │ ← │   │ → │ - │
     * ├───┼───┼───┼───┤
     * │End│ ↓ │PgD│ + │
     * ├───┼───┼───┼───┤
     * │INS│ . │DEL│ENT│
     * └───┴───┴───┴───┘
     */
    [1] = LAYOUT_numpad_5x4(
        TO(2),   _______, _______, _______,
        KC_HOME, KC_UP,   KC_PGUP, _______,
        KC_LEFT, XXXXXXX, KC_RGHT, _______,
        KC_END,  KC_DOWN, KC_PGDN, _______,
        KC_INS,  _______, KC_DEL,  _______
    ),

     /*
     * ┌───┬───┬───┬───┐
     * │TG1│CAP│ / │ M │
     * ┌───┬───┬───┬───┤
     * │Hom│ ↑ │PgU│ * │
     * ├───┼───┼───┼───┤
     * │ ← │   │ → │ - │
     * ├───┼───┼───┼───┤
     * │End│ ↓ │PgD│ + │
     * ├───┼───┼───┼───┤
     * │INS│ . │DEL│ENT│
     * └───┴───┴───┴───┘
     */
    [2] = LAYOUT_numpad_5x4(
        TO(0),      _______,    _______,    _______,
        UM(MU),   UM(SIGMA), UM(DEGREE), UM(PLSMNS),
        UM(BANG), UM(IRONY),   UM(SNEK),    _______,
        _______,    _______,    _______,    _______,
        _______,    _______,    _______,    _______
    )

};

#ifdef OLED_ENABLE

static const char PROGMEM idle[IDLE_FRAMES][ANIM_SIZE] = {
    {
        0x00, 0x00, 0x00, 0x00, 0x00, 0x00, 0x00, 0x00, 0x00, 0x00, 0x00, 0x00,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 0x00,
        0x00, 0x00, 0x00, 0x00, 0x00, 0x00, 0x00, 0x00, 0x00, 0x00, 0x00, 0x00,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 0x01,
        0x00, 0x00, 0x00, 0x00, 0x00, 0x00, 0x00, 0x00, 0x00, 0x00, 0x00, 0x00,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 0x00,
        0x00, 0x00, 0x00, 0x00, 0x00, 0x00, 0x00, 0x00, 0x00, 0x00, 0x00, 0x00,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 0x00
    },
    {
        0x00, 0x00, 0x00, 0x00, 0x00, 0x00, 0x00, 0x00, 0x00, 0x00, 0x00, 0x00,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 0x00,
        0x00, 0x00, 0x00, 0x00, 0x00, 0x00, 0x00, 0x00, 0x00, 0x00, 0x00, 0x00,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 0x01,
        0x00, 0x00, 0x00, 0x00, 0x00, 0x00, 0x00, 0x00, 0x00, 0x00, 0x00, 0x00,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 0x00,
        0x00, 0x00, 0x00, 0x00, 0x00, 0x00, 0x00, 0x00, 0x00, 0x00, 0x00, 0x00,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 0x00
    },
    {
        0x00, 0x00, 0x00, 0x00, 0x00, 0x00, 0x00, 0x00, 0x00, 0x00, 0x00, 0x00,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 0x00,
        0x00, 0x00, 0x00, 0x00, 0x00, 0x00, 0x00, 0x00, 0x00, 0x00, 0x00, 0x00,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 0x01,
        0x00, 0x00, 0x00, 0x00, 0x00, 0x00, 0x00, 0x00, 0x00, 0x00, 0x00, 0x00,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 0x00,
        0x00, 0x00, 0x00, 0x00, 0x00, 0x00, 0x00, 0x00, 0x00, 0x00, 0x00, 0x00,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 0x00
    },
    {
        0x00, 0x00, 0x00, 0x00, 0x00, 0x00, 0x00, 0x00, 0x00, 0x00, 0x00, 0x00,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 0x00,
        0x00, 0x00, 0x00, 0x00, 0x00, 0x00, 0x00, 0x00, 0x00, 0x00, 0x00, 0x00,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 0x01,
        0x00, 0x00, 0x00, 0x00, 0x00, 0x00, 0x00, 0x00, 0x00, 0x00, 0x00, 0x00,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 0x00,
        0x00, 0x00, 0x00, 0x00, 0x00, 0x00, 0x00, 0x00, 0x00, 0x00, 0x00, 0x00,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 0x00
    },
    {
        0x00, 0x00, 0x00, 0x00, 0x00, 0x00, 0x00, 0x00, 0x00, 0x00, 0x00, 0x00,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 0x00,
        0x00, 0x00, 0x00, 0x00, 0x00, 0x00, 0x00, 0x00, 0x00, 0x00, 0x00, 0x00,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 0x01,
        0x00, 0x00, 0x00, 0x00, 0x00, 0x00, 0x00, 0x00, 0x00, 0x00, 0x00, 0x00,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 0x00,
        0x00, 0x00, 0x00, 0x00, 0x00, 0x00, 0x00, 0x00, 0x00, 0x00, 0x00, 0x00,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 0x00
    }
};

static const char PROGMEM prep[][ANIM_SIZE] = {
    {
        0x00, 0x00, 0x00, 0x00, 0x00, 0x00, 0x00, 0x00, 0x00, 0x00, 0x00, 0x00,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 0x00,
        0x00, 0x00, 0x00, 0x00, 0x00, 0x00, 0x00, 0x00, 0x00, 0x00, 0x00, 0x00,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 0x01,
        0x00, 0x00, 0x00, 0x00, 0x00, 0x00, 0x00, 0x00, 0x00, 0x00, 0x00, 0x00,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 0x00,
        0x00, 0x00, 0x00, 0x00, 0x00, 0x00, 0x00, 0x00, 0x00, 0x00, 0x00, 0x00,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 0x00
    }
};

static const char PROGMEM tap[TAP_FRAMES][ANIM_SIZE] = {
    {
        0x00, 0x00, 0x00, 0x00, 0x00, 0x00, 0x00, 0x00, 0x00, 0x00, 0x00, 0x00,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 0x00,
        0x00, 0x00, 0x00, 0x00, 0x00, 0x00, 0x00, 0x00, 0x00, 0x00, 0x00, 0x00,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 0x01,
        0x00, 0x00, 0x00, 0x00, 0x00, 0x00, 0x00, 0x00, 0x00, 0x00, 0x00, 0x00,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 0x00,
        0x00, 0x00, 0x00, 0x00, 0x00, 0x00, 0x00, 0x00, 0x00, 0x00, 0x00, 0x00,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 0x00
    },
    {
        0x00, 0x00, 0x00, 0x00, 0x00, 0x00, 0x00, 0x00, 0x00, 0x00, 0x00, 0x00,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 0x00,
        0x00, 0x00, 0x00, 0x00, 0x00, 0x00, 0x00, 0x00, 0x00, 0x00, 0x00, 0x00,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 0x01,
        0x00, 0x00, 0x00, 0x00, 0x00, 0x00, 0x00, 0x00, 0x00, 0x00, 0x00, 0x00,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 0x00,
        0x00, 0x00, 0x00, 0x00, 0x00, 0x00, 0x00, 0x00, 0x00, 0x00, 0x00, 0x00,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 0x00
    }
};

bool detect_key_down(void) {
    // store the previous cycle's cache
    for (uint8_t i = 0; i < KEYS_SIZE; ++i) {
        pressed_keys_prev[i].first = pressed_keys[i].first;
        pressed_keys_prev[i].second = pressed_keys[i].second;
    }

    // fill cache with currently pressed keys
    pressed_keys_index = 0;
    for (uint8_t x = 0; x < MATRIX_ROWS; x++) {
        for (uint8_t y = 0; y < MATRIX_COLS; y++) {
            // is this key is currently down?
            if (((matrix_get_row(x) & (1 << y)) > 0)) {
                pressed_keys[pressed_keys_index].first = x+1; // adding 1 to the row/col so that we can use 0 as a null-check
                pressed_keys[pressed_keys_index].second = y+1;
            }
            else {
                pressed_keys[pressed_keys_index].first = 0;
                pressed_keys[pressed_keys_index].second = 0;
            }
            pressed_keys_index++;
        }
    }

    // check for a new key down compared to last cycle
    for (uint8_t i = 0; i < KEYS_SIZE; ++i) {
        if (pressed_keys[i].first && pressed_keys[i].second && !pressed_keys_prev[i].first && !pressed_keys_prev[i].second) {
            return true;
        }
    }
    return false;
}

void eval_anim_state(void) {
    key_down = detect_key_down();
    switch (anim_state) {
        case Idle:
            if (key_down) { // Idle to Tap
                anim_state = Tap;
            }
            break;

        case Prep:
            if (key_down) {// Prep to Tap
                anim_state = Tap;
            }
            else if (timer_elapsed32(idle_timeout_timer) >= IDLE_TIMEOUT) {// Prep to Idle
                anim_state = Idle;
                current_idle_frame = 0;
            }
            break;

        case Tap:
            if (!key_down) {// Tap to Prep
                anim_state = Prep;
                idle_timeout_timer = timer_read32();
            }
            break;

        default:
            break;
    }
}

static void draw_bongo(void) {

    eval_anim_state();

    oled_set_cursor(0, 0);

    switch (anim_state) {
        case Idle:
            oled_write_raw_P(idle[abs((IDLE_FRAMES - 1) - current_idle_frame)], ANIM_SIZE);

            if (timer_elapsed32(anim_timer) > ANIM_FRAME_DURATION) {
                current_idle_frame = (current_idle_frame + 1) % IDLE_FRAMES;
                anim_timer = timer_read32();
            }
            break;

        case Prep:
            oled_write_raw_P(prep[0], ANIM_SIZE);
            break;

        case Tap:
            oled_write_raw_P(tap[abs((TAP_FRAMES - 1) - current_tap_frame)], ANIM_SIZE);
            current_tap_frame = (current_tap_frame + 1) % TAP_FRAMES;
            break;

        default:
            break;
    }
}
// Draw to OLED
bool oled_task_user() {

    draw_bongo();

    // Set cursor position
    oled_set_cursor(0,5);
    sprintf(wpm_str, "WPM  %03d", get_current_wpm());
    oled_write(wpm_str, false);

    // Set cursor position
    oled_set_cursor(0,6);
    //Swith on current active layer
    switch (get_highest_layer(layer_state)){
        case _MAC_NUMPAD :
            oled_write("Numpad Layer  ", false);
            break;
        case _MAC_NUM_LOCK :
            oled_write("Num Lock Layer", false);
            break;
        case _MAC_SYMBOLS :
            oled_write("Symbols Layer ", false);
            break;
    }
    // Set cursor position
    oled_set_cursor(0,7);

    // Caps lock status
    led_t led_state = host_keyboard_led_state();
    oled_write_P(led_state.caps_lock ? PSTR("Caps Lock: On ") : PSTR("Caps Lock: Off"), false);

    return false;
}
#endif
